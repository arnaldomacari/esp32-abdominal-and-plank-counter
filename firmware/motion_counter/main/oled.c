#include "oled.h"
#include "i2c_bus.h"

#include <stdio.h>
#include <string.h>
#include <stdarg.h>
#include <stdint.h>

#include "freertos/FreeRTOS.h"
#include "freertos/task.h"

#include "esp_log.h"

#define OLED_ADDR       0x3C
#define OLED_WIDTH      128
#define OLED_HEIGHT     64
#define OLED_PAGES      8

static const char *TAG = "oled";

static const uint8_t font5x7[][5] = {
    [' '] = {0x00,0x00,0x00,0x00,0x00},
    ['-'] = {0x08,0x08,0x08,0x08,0x08},
    ['.'] = {0x00,0x60,0x60,0x00,0x00},
    [':'] = {0x00,0x36,0x36,0x00,0x00},
    ['0'] = {0x3E,0x51,0x49,0x45,0x3E},
    ['1'] = {0x00,0x42,0x7F,0x40,0x00},
    ['2'] = {0x42,0x61,0x51,0x49,0x46},
    ['3'] = {0x21,0x41,0x45,0x4B,0x31},
    ['4'] = {0x18,0x14,0x12,0x7F,0x10},
    ['5'] = {0x27,0x45,0x45,0x45,0x39},
    ['6'] = {0x3C,0x4A,0x49,0x49,0x30},
    ['7'] = {0x01,0x71,0x09,0x05,0x03},
    ['8'] = {0x36,0x49,0x49,0x49,0x36},
    ['9'] = {0x06,0x49,0x49,0x29,0x1E},
    ['A'] = {0x7E,0x11,0x11,0x11,0x7E},
    ['B'] = {0x7F,0x49,0x49,0x49,0x36},
    ['C'] = {0x3E,0x41,0x41,0x41,0x22},
    ['D'] = {0x7F,0x41,0x41,0x22,0x1C},
    ['E'] = {0x7F,0x49,0x49,0x49,0x41},
    ['F'] = {0x7F,0x09,0x09,0x09,0x01},
    ['G'] = {0x3E,0x41,0x49,0x49,0x7A},
    ['H'] = {0x7F,0x08,0x08,0x08,0x7F},
    ['I'] = {0x00,0x41,0x7F,0x41,0x00},
    ['J'] = {0x20,0x40,0x41,0x3F,0x01},
    ['K'] = {0x7F,0x08,0x14,0x22,0x41},
    ['L'] = {0x7F,0x40,0x40,0x40,0x40},
    ['M'] = {0x7F,0x02,0x0C,0x02,0x7F},
    ['N'] = {0x7F,0x04,0x08,0x10,0x7F},
    ['O'] = {0x3E,0x41,0x41,0x41,0x3E},
    ['P'] = {0x7F,0x09,0x09,0x09,0x06},
    ['Q'] = {0x3E,0x41,0x51,0x21,0x5E},
    ['R'] = {0x7F,0x09,0x19,0x29,0x46},
    ['S'] = {0x46,0x49,0x49,0x49,0x31},
    ['T'] = {0x01,0x01,0x7F,0x01,0x01},
    ['U'] = {0x3F,0x40,0x40,0x40,0x3F},
    ['V'] = {0x1F,0x20,0x40,0x20,0x1F},
    ['W'] = {0x7F,0x20,0x18,0x20,0x7F},
    ['X'] = {0x63,0x14,0x08,0x14,0x63},
    ['Y'] = {0x07,0x08,0x70,0x08,0x07},
    ['Z'] = {0x61,0x51,0x49,0x45,0x43},
    ['a'] = {0x20,0x54,0x54,0x54,0x78},
    ['b'] = {0x7F,0x48,0x44,0x44,0x38},
    ['c'] = {0x38,0x44,0x44,0x44,0x20},
    ['d'] = {0x38,0x44,0x44,0x48,0x7F},
    ['e'] = {0x38,0x54,0x54,0x54,0x18},
    ['f'] = {0x08,0x7E,0x09,0x01,0x02},
    ['g'] = {0x0C,0x52,0x52,0x52,0x3E},
    ['h'] = {0x7F,0x08,0x04,0x04,0x78},
    ['i'] = {0x00,0x44,0x7D,0x40,0x00},
    ['j'] = {0x20,0x40,0x44,0x3D,0x00},
    ['k'] = {0x7F,0x10,0x28,0x44,0x00},
    ['l'] = {0x00,0x41,0x7F,0x40,0x00},
    ['m'] = {0x7C,0x04,0x18,0x04,0x78},
    ['n'] = {0x7C,0x08,0x04,0x04,0x78},
    ['o'] = {0x38,0x44,0x44,0x44,0x38},
    ['p'] = {0x7C,0x14,0x14,0x14,0x08},
    ['q'] = {0x08,0x14,0x14,0x18,0x7C},
    ['r'] = {0x7C,0x08,0x04,0x04,0x08},
    ['s'] = {0x48,0x54,0x54,0x54,0x20},
    ['t'] = {0x04,0x3F,0x44,0x40,0x20},
    ['u'] = {0x3C,0x40,0x40,0x20,0x7C},
    ['v'] = {0x1C,0x20,0x40,0x20,0x1C},
    ['w'] = {0x3C,0x40,0x30,0x40,0x3C},
    ['x'] = {0x44,0x28,0x10,0x28,0x44},
    ['y'] = {0x0C,0x50,0x50,0x50,0x3C},
    ['z'] = {0x44,0x64,0x54,0x4C,0x44},
};

static esp_err_t oled_cmd(uint8_t cmd)
{
    uint8_t data[2] = {0x00, cmd};
    return i2c_bus_write_bytes(OLED_ADDR, data, sizeof(data));
}

static esp_err_t oled_data(const uint8_t *data, size_t len)
{
    uint8_t buffer[17];
    size_t offset = 0;

    while (offset < len) {
        size_t chunk = len - offset;

        if (chunk > 16) {
            chunk = 16;
        }

        buffer[0] = 0x40;
        memcpy(&buffer[1], &data[offset], chunk);

        esp_err_t ret = i2c_bus_write_bytes(OLED_ADDR, buffer, chunk + 1);

        if (ret != ESP_OK) {
            return ret;
        }

        offset += chunk;
    }

    return ESP_OK;
}

esp_err_t oled_init(void)
{
    vTaskDelay(pdMS_TO_TICKS(100));

    uint8_t cmds[] = {
        0xAE,
        0xD5, 0x80,
        0xA8, 0x3F,
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        0xA6,
        0xAF
    };

    for (size_t i = 0; i < sizeof(cmds); i++) {
        esp_err_t ret = oled_cmd(cmds[i]);
        if (ret != ESP_OK) {
            ESP_LOGE(TAG, "Erro inicializando OLED: %s", esp_err_to_name(ret));
            return ret;
        }
    }

    oled_clear();
    ESP_LOGI(TAG, "OLED SSD1306 iniciado em 0x%02X", OLED_ADDR);

    return ESP_OK;
}

void oled_set_cursor(int col, int page)
{
    if (col < 0) col = 0;
    if (col > 127) col = 127;
    if (page < 0) page = 0;
    if (page > 7) page = 7;

    oled_cmd(0xB0 + page);
    oled_cmd(0x00 + (col & 0x0F));
    oled_cmd(0x10 + ((col >> 4) & 0x0F));
}

void oled_clear(void)
{
    uint8_t zeros[OLED_WIDTH];
    memset(zeros, 0x00, sizeof(zeros));

    for (int page = 0; page < OLED_PAGES; page++) {
        oled_set_cursor(0, page);
        oled_data(zeros, sizeof(zeros));
    }

    oled_set_cursor(0, 0);
}

void oled_write_text(const char *text)
{
    while (*text) {
        char c = *text++;

        if ((unsigned char)c > 127) {
            c = '?';
        }

        uint8_t ch[6] = {0};

        memcpy(ch, font5x7[(uint8_t)c], 5);
        ch[5] = 0x00;

        oled_data(ch, sizeof(ch));
    }
}

void oled_printf(int col, int page, const char *fmt, ...)
{
    char buffer[32];

    va_list args;
    va_start(args, fmt);
    vsnprintf(buffer, sizeof(buffer), fmt, args);
    va_end(args);

    oled_set_cursor(col, page);
    oled_write_text(buffer);
}